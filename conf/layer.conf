## conf/layer.conf
```bitbake
# We have a conf and classes directory, add to BBPATH
BBPATH .= ":${LAYERDIR}"

# We have a packages directory, add to BBFILES
BBFILES += "${LAYERDIR}/recipes-*/*/*.bb \
            ${LAYERDIR}/recipes-*/*/*.bbappend"

BBFILE_COLLECTIONS += "gigatronik"
BBFILE_PATTERN_gigatronik := "^${LAYERDIR}/"
BBFILE_PRIORITY_gigatronik = "10"

#set password for root
INHERIT += "extrausers"
EXTRA_USERS_PARAMS = "usermod -P root1 root;"

#to set extra users:
EXTRA_USERS_PARAMS = "useradd -P root1 abcd;"

PREFERRED_PROVIDER_virtual/kernel ?= "linux-imx"

LAYERDEPENDS_gigatronik = "fsl-arm fsl-arm-extra gigatronik fsl-bsp-release "
```

## conf/machine/imx6sxsabresd.conf
```bitbake
#@TYPE: Machine
#@NAME: Freescale i.MX6SoloX SabreSD
#@SOC: i.MX6SX
#@DESCRIPTION: Machine configuration for Freescale i.MX6SoloX Sabre SD
#@MAINTAINER: Lauren Post <Lauren.Post@freescale.com>

require conf/machine/include/imx6sabresd-common.inc

SOC_FAMILY = "mx6:mx6sx"

KERNEL_DEVICETREE += "imx6sx-sdb-lcdM4.dtb"

UBOOT_ENTRYPOINT = "0x80008000"
aydfgydf
#PREFERRED_PROVIDER_virtual/kernel ?= "linux-imx"

UBOOT_CONFIG ??= "sd"
UBOOT_CONFIG[sd] = "mx6sxsabresd_config,sdcard"
UBOOT_CONFIG[emmc] = "mx6sxsabresd_emmc_config,sdcard"
UBOOT_CONFIG[qspi2] = "mx6sxsabresd_qspi2_config"
UBOOT_CONFIG[m4fastup] = "mx6sxsabresd_m4fastup_config"
UBOOT_CONFIG[mfgtool] = "mx6sxsabresd_config"
```
